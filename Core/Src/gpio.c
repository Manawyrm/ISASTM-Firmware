#include "gpio.h"

const struct iopin iopins[] = {
	/* Debug LEDs */ 
	{ GPIOG, GPIO_PIN_9,  GPIO_MODE_OUTPUT_PP, GPIO_FLAG_DEFAULT_ACTIVE },// LED1
	{ GPIOG, GPIO_PIN_10, GPIO_MODE_OUTPUT_PP },// LED2
	{ GPIOG, GPIO_PIN_11, GPIO_MODE_OUTPUT_PP },// LED3
	{ GPIOG, GPIO_PIN_12, GPIO_MODE_OUTPUT_PP },// LED4
	{ GPIOG, GPIO_PIN_13, GPIO_MODE_OUTPUT_PP },// LED5

    /* Level shifter control */
    { GPIOH, GPIO_PIN_14, GPIO_MODE_OUTPUT_PP, 0 },// ADDRESS_DIR
	{ GPIOH, GPIO_PIN_15, GPIO_MODE_OUTPUT_PP, GPIO_FLAG_ACTIVE_LOW | GPIO_FLAG_DEFAULT_ACTIVE},// ~ADDRESS_OE

	{ GPIOD, GPIO_PIN_4, GPIO_MODE_OUTPUT_PP, 0 },// DATA_DIR
	{ GPIOD, GPIO_PIN_3, GPIO_MODE_OUTPUT_PP, GPIO_FLAG_ACTIVE_LOW | GPIO_FLAG_DEFAULT_ACTIVE },// ~DATA_OE

	{ GPIOD, GPIO_PIN_6, GPIO_MODE_OUTPUT_PP, 0 },// CONTROL1_DIR
	{ GPIOD, GPIO_PIN_5, GPIO_MODE_OUTPUT_PP, GPIO_FLAG_ACTIVE_LOW | GPIO_FLAG_DEFAULT_ACTIVE },// ~CONTROL1_OE

	{ GPIOH, GPIO_PIN_11, GPIO_MODE_OUTPUT_PP, 0 },// CONTROL2_DIR
	{ GPIOH, GPIO_PIN_12, GPIO_MODE_OUTPUT_PP, GPIO_FLAG_ACTIVE_LOW },// ~CONTROL2_OE

	{ GPIOF, GPIO_PIN_9, GPIO_MODE_OUTPUT_PP, 0 },// CONTROL3_DIR
	{ GPIOF, GPIO_PIN_10, GPIO_MODE_OUTPUT_PP, GPIO_FLAG_ACTIVE_LOW | GPIO_FLAG_DEFAULT_ACTIVE },// ~CONTROL3_OE

	{ GPIOB, GPIO_PIN_14, GPIO_MODE_OUTPUT_PP, 0 },// SPARE1_DIR
	{ GPIOH, GPIO_PIN_8, GPIO_MODE_OUTPUT_PP , GPIO_FLAG_ACTIVE_LOW },// ~SPARE1_OE

	{ GPIOF, GPIO_PIN_7, GPIO_MODE_OUTPUT_PP, 0 },// SPARE2_DIR
	{ GPIOF, GPIO_PIN_8, GPIO_MODE_OUTPUT_PP, GPIO_FLAG_ACTIVE_LOW },// ~SPARE2_OE

	{ GPIOF, GPIO_PIN_6, GPIO_MODE_OUTPUT_PP,  GPIO_FLAG_DEFAULT_ACTIVE },// IRQ_DIR
	{ GPIOH, GPIO_PIN_13, GPIO_MODE_OUTPUT_PP, GPIO_FLAG_ACTIVE_LOW | GPIO_FLAG_DEFAULT_ACTIVE },// ~IRQ_OE

	/* ISA I/Os */
	{ GPIOA, GPIO_PIN_0, GPIO_MODE_INPUT, GPIO_FLAG_ACTIVE_LOW },// ~DACK3
	{ GPIOA, GPIO_PIN_1, GPIO_MODE_INPUT },// CLK
	{ GPIOA, GPIO_PIN_2, GPIO_MODE_INPUT, GPIO_FLAG_ACTIVE_LOW },// ~NOWS
	{ GPIOA, GPIO_PIN_8, GPIO_MODE_INPUT },// DRQ1
	{ GPIOA, GPIO_PIN_9, GPIO_MODE_INPUT },// IRQ2
	{ GPIOA, GPIO_PIN_10, GPIO_MODE_INPUT },// DRQ3
	{ GPIOA, GPIO_PIN_15, GPIO_MODE_OUTPUT_PP, GPIO_FLAG_DEFAULT_ACTIVE },// ALE

	{ GPIOB, GPIO_PIN_4, GPIO_MODE_INPUT, GPIO_FLAG_ACTIVE_LOW | GPIO_FLAG_PULL_UP },// ~REFRESH
	{ GPIOB, GPIO_PIN_6, GPIO_MODE_OUTPUT_PP, GPIO_FLAG_ACTIVE_LOW },// ~MEMW
	{ GPIOB, GPIO_PIN_7, GPIO_MODE_OUTPUT_PP, GPIO_FLAG_ACTIVE_LOW },// ~MEMR
	{ GPIOB, GPIO_PIN_8, GPIO_MODE_OUTPUT_PP, GPIO_FLAG_ACTIVE_LOW },// ~IOW
	{ GPIOB, GPIO_PIN_9, GPIO_MODE_OUTPUT_PP, GPIO_FLAG_ACTIVE_LOW },// ~IOR
	{ GPIOB, GPIO_PIN_15, GPIO_MODE_INPUT },// IRQ3

	{ GPIOC, GPIO_PIN_5, GPIO_MODE_OUTPUT_PP },// A5
	{ GPIOC, GPIO_PIN_6, GPIO_MODE_OUTPUT_PP },// A6
	{ GPIOC, GPIO_PIN_7, GPIO_MODE_OUTPUT_PP },// A7
	{ GPIOC, GPIO_PIN_8, GPIO_MODE_OUTPUT_PP },// A8
	{ GPIOC, GPIO_PIN_9, GPIO_MODE_OUTPUT_PP },// A9
	{ GPIOC, GPIO_PIN_10, GPIO_MODE_OUTPUT_PP },// A10
	{ GPIOC, GPIO_PIN_11, GPIO_MODE_OUTPUT_PP },// A11
	{ GPIOC, GPIO_PIN_12, GPIO_MODE_OUTPUT_PP },// A12
	{ GPIOC, GPIO_PIN_13, GPIO_MODE_OUTPUT_PP },// A13
	{ GPIOC, GPIO_PIN_14, GPIO_MODE_OUTPUT_PP },// A14
	{ GPIOC, GPIO_PIN_15, GPIO_MODE_OUTPUT_PP },// A15

	{ GPIOD, GPIO_PIN_2, GPIO_MODE_OUTPUT_PP },// AEN
	{ GPIOD, GPIO_PIN_7, GPIO_MODE_INPUT },// IRQ7
	{ GPIOD, GPIO_PIN_11, GPIO_MODE_INPUT },// IRQ4
	{ GPIOD, GPIO_PIN_12, GPIO_MODE_INPUT },// IRQ5
	{ GPIOD, GPIO_PIN_13, GPIO_MODE_INPUT },// IRQ6

	{ GPIOE, GPIO_PIN_2, GPIO_MODE_OUTPUT_PP },// A0
	{ GPIOE, GPIO_PIN_3, GPIO_MODE_OUTPUT_PP },// A1
	{ GPIOE, GPIO_PIN_4, GPIO_MODE_OUTPUT_PP },// A2
	{ GPIOE, GPIO_PIN_5, GPIO_MODE_OUTPUT_PP },// A3
	{ GPIOE, GPIO_PIN_6, GPIO_MODE_OUTPUT_PP },// A4

	{ GPIOG, GPIO_PIN_3, GPIO_MODE_INPUT },// DRQ2
	{ GPIOG, GPIO_PIN_6, GPIO_MODE_INPUT, GPIO_FLAG_ACTIVE_LOW },// ~IO_CH_CK
	{ GPIOG, GPIO_PIN_7, GPIO_MODE_INPUT },// IO_CH_RDY
	{ GPIOG, GPIO_PIN_14, GPIO_MODE_OUTPUT_PP },// RESET

	{ GPIOH, GPIO_PIN_2, GPIO_MODE_INPUT, GPIO_FLAG_ACTIVE_LOW },// ~DACK2
	{ GPIOH, GPIO_PIN_3, GPIO_MODE_INPUT, GPIO_FLAG_ACTIVE_LOW },// ~DACK1
	{ GPIOH, GPIO_PIN_4, GPIO_MODE_OUTPUT_PP },// TC

	{ GPIOI, GPIO_PIN_0, GPIO_MODE_OUTPUT_PP },// D0
	{ GPIOI, GPIO_PIN_1, GPIO_MODE_OUTPUT_PP },// D1
	{ GPIOI, GPIO_PIN_2, GPIO_MODE_OUTPUT_PP },// D2
	{ GPIOI, GPIO_PIN_3, GPIO_MODE_OUTPUT_PP },// D3
	{ GPIOI, GPIO_PIN_4, GPIO_MODE_OUTPUT_PP },// D4
	{ GPIOI, GPIO_PIN_5, GPIO_MODE_OUTPUT_PP },// D5
	{ GPIOI, GPIO_PIN_6, GPIO_MODE_OUTPUT_PP },// D6
	{ GPIOI, GPIO_PIN_7, GPIO_MODE_OUTPUT_PP },// D7

	{ GPIOI, GPIO_PIN_8, GPIO_MODE_OUTPUT_PP },// A16
	{ GPIOI, GPIO_PIN_9, GPIO_MODE_OUTPUT_PP },// A17
	{ GPIOI, GPIO_PIN_10, GPIO_MODE_OUTPUT_PP },// A18
	{ GPIOI, GPIO_PIN_11, GPIO_MODE_OUTPUT_PP },// A19
};


void init_isastm()
{
	__HAL_RCC_GPIOA_CLK_ENABLE();
	__HAL_RCC_GPIOB_CLK_ENABLE();
	__HAL_RCC_GPIOC_CLK_ENABLE();
	__HAL_RCC_GPIOD_CLK_ENABLE();
	__HAL_RCC_GPIOE_CLK_ENABLE();
	__HAL_RCC_GPIOF_CLK_ENABLE();
	__HAL_RCC_GPIOG_CLK_ENABLE();
	__HAL_RCC_GPIOH_CLK_ENABLE();
	__HAL_RCC_GPIOI_CLK_ENABLE();

	for (int i = 0; i < ARRAY_SIZE(iopins); ++i)
	{
		GPIO_InitTypeDef GPIO_InitStruct;
		GPIO_InitStruct.Pin = iopins[i].pin;
		GPIO_InitStruct.Mode = iopins[i].mode;

		if (iopins[i].flags & GPIO_FLAG_PULL_UP)
			GPIO_InitStruct.Pull = GPIO_PULLUP;

		if (iopins[i].flags & GPIO_FLAG_PULL_DOWN)
			GPIO_InitStruct.Pull = GPIO_PULLDOWN;

		GPIO_InitStruct.Speed = GPIO_SPEED_FREQ_VERY_HIGH;
		HAL_GPIO_Init(iopins[i].port, &GPIO_InitStruct); 

		gpio_write(iopins[i], !!(iopins[i].flags & GPIO_FLAG_DEFAULT_ACTIVE));
	}
}

void gpio_write(const struct iopin iopin, const uint8_t value)
{
	if (!(iopin.flags & GPIO_FLAG_ACTIVE_LOW) != !value)
	{
		iopin.port->BSRR = iopin.pin;
	}
	else
	{
		iopin.port->BSRR = (uint32_t)iopin.pin << GPIO_NUMBER;
	}
}

void gpio_set(const struct iopin iopin)
{
	if (iopin.flags & GPIO_FLAG_ACTIVE_LOW)
	{
		iopin.port->BSRR = (uint32_t)iopin.pin << GPIO_NUMBER;
	}
	else
	{
		iopin.port->BSRR = iopin.pin;
	}
}

void gpio_reset(const struct iopin iopin)
{
	if (iopin.flags & GPIO_FLAG_ACTIVE_LOW)
	{
		iopin.port->BSRR = iopin.pin;
	}
	else
	{
		iopin.port->BSRR = (uint32_t)iopin.pin << GPIO_NUMBER;
	}
}

uint8_t gpio_read(const struct iopin iopin)
{
	if (iopin.flags & GPIO_FLAG_ACTIVE_LOW)
		return !(iopin.port->IDR & iopin.pin);
	else
		return !!(iopin.port->IDR & iopin.pin);
}